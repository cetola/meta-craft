## conf/bblayers.conf.sample
```bitbake
LCONF_VERSION = "6"

BBPATH = "${TOPDIR}"
BBFILES ?= ""

BBLAYERS ?= " \
    ##COREBASE##/meta \
    ##COREBASE##/meta-selftest \
    ##COREBASE##/meta-craft \
"
```

## conf/distro/craft.conf
```bitbake
DISTRO = "craft"
DISTRO_NAME = "Craft Technology Embedded Linux"
DISTRO_VERSION = "1.0"
SDK_VENDOR = "-craftsdk"
SDK_VERSION := "${@'${DISTRO_VERSION}'.replace('snapshot-${DATE}','snapshot')}"

MAINTAINER = "Stephano Cetola <stephano.cetola@linux.intel.com>"

TARGET_VENDOR = "-craft"

CRAFT_DEFAULT_DISTRO_FEATURES = "\
alsa argp bluetooth ext2 irda largefile pcmcia\
usbgadget usbhost wifi xattr nfs zeroconf pci 3g nfc x11\
"

DISTRO_FEATURES = "\
    ${DISTRO_FEATURES_LIBC} \
    ${CRAFT_DEFAULT_DISTRO_FEATURES} \
"

LOCALCONF_VERSION = "1"
```
